#include "Arduboy.h"

PROGMEM const byte background[128*8] = {
0,0,0,0,0,0,0,0,0,0,0,0,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0,
0,0,0,0,0,0,0,0,0,0,0,0,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0,
0,0,0,0,0,0,0,0,0,0,0,0,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0,
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0,0,0,0,0,0,0,0,0,0,0,0,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0,
  };

#define STATIC_SPRITE(name, x, y, w, h, ...) PROGMEM const byte name[w*h/8+4] = {x, y, w, h, __VA_ARGS__}

STATIC_SPRITE(BT0, 23, 40, 21, 16,
              56,124,126,246,254,252,156,0,0,0,0,0,0,0,0,0,0,0,0,0,0,
              0,6,7,7,7,7,7,15,30,118,102,6,6,6,6,6,6,6,6,6,0);

STATIC_SPRITE(BT1, 44, 40, 21, 16,
              56,124,254,218,158,158,204,0,0,0,0,0,0,0,0,0,0,0,0,0,0,
              0,7,7,7,7,63,63,6,6,6,6,6,6,6,6,6,6,6,6,6,0);

STATIC_SPRITE(BT2, 65, 40, 21, 16,
              0,0,60,126,218,222,158,140,128,0,0,0,0,0,0,0,0,0,0,0,0,
              0,6,102,119,31,15,7,7,7,6,6,6,6,6,6,6,6,6,6,6,0);

STATIC_SPRITE(T11, 81,  2, 6, 8, 63, 33, 33, 33, 33, 63);
STATIC_SPRITE(T12, 71,  3, 6, 8, 63, 33, 33, 33, 33, 63);
STATIC_SPRITE(T13, 62,  7, 6, 8, 63, 33, 33, 33, 33, 63);
STATIC_SPRITE(T14, 53, 13, 6, 8, 63, 33, 33, 33, 33, 63);
STATIC_SPRITE(T15, 45, 21, 6, 8, 63, 33, 33, 33, 33, 63);
STATIC_SPRITE(T16, 40, 31, 6, 8, 63, 33, 33, 33, 33, 63);
STATIC_SPRITE(T17, 35, 43, 6, 8, 63, 33, 33, 33, 33, 63);

STATIC_SPRITE(T21, 85,  8, 6, 8, 63, 33, 33, 33, 33, 63);
STATIC_SPRITE(T22, 77,  8, 6, 8, 63, 33, 33, 33, 33, 63);
STATIC_SPRITE(T23, 70, 13, 6, 8, 63, 33, 33, 33, 33, 63);
STATIC_SPRITE(T24, 63, 20, 6, 8, 63, 33, 33, 33, 33, 63);
STATIC_SPRITE(T25, 59, 31, 6, 8, 63, 33, 33, 33, 33, 63);
STATIC_SPRITE(T26, 55, 43, 6, 8, 63, 33, 33, 33, 33, 63);

STATIC_SPRITE(T31, 93, 13, 6, 8, 63, 33, 33, 33, 33, 63);
STATIC_SPRITE(T32, 86, 16, 6, 8, 63, 33, 33, 33, 33, 63);
STATIC_SPRITE(T33, 79, 22, 6, 8, 63, 33, 33, 33, 33, 63);
STATIC_SPRITE(T34, 77, 31, 6, 8, 63, 33, 33, 33, 33, 63);
STATIC_SPRITE(T35, 76, 43, 6, 8, 63, 33, 33, 33, 33, 63);

const byte * const Tracks[3][7] = {
  {T11, T12, T13, T14, T15, T16, T17},
  {0, T21, T22, T23, T24, T25, T26},
  {0, 0, T31, T32, T33, T34, T35}
};

// Make an instance of arduboy used for many functions
Arduboy arduboy;

byte frame = 0;
byte boat_pos = 0;
unsigned short score = 1234;
byte troopers[16] = {1,2,3,4,5,6,7,8,9,10,11,12,13,14,15,0};
byte shark = 0;
byte miss = 3;

void new_game(char game_type){
  frame = 0;
  score = 0;
  for (byte i=0; i<sizeof(troopers); i++){
    troopers[i] = i+1;
  }
  troopers[sizeof(troopers)-1] = 0;
  shark = 0;
  miss = 0;
}

void make_trooper(byte track, byte pos){
  byte i = troopers[0];
  if (i == 0) return; // no free slots
  troopers[0] = troopers[i];
  troopers[i] = (track << 6) | (pos << 3);
}

void kill_trooper(byte i){
  troopers[i] = troopers[0];
  troopers[0] = i;
}

void setup() {
  // put your setup code here, to run once:
  arduboy.begin();
  arduboy.setFrameRate(8);
  draw();
  arduboy.display();
}

void draw_static_sprite(byte* sprite){
  arduboy.drawBitmap(pgm_read_byte(sprite+0), pgm_read_byte(sprite+1), 
                     sprite+4, 
                     pgm_read_byte(sprite+2), pgm_read_byte(sprite+3), 
                     0);
}

void drawScore(){
  unsigned int sc = score;
  arduboy.drawChar(37, 2, sc%10+'0', 0, 1, 1);
  sc /= 10;
  arduboy.drawChar(30, 2, sc%10+'0', 0, 1, 1);
  sc /= 10;
  arduboy.drawChar(23, 2, sc%10+'0', 0, 1, 1);
  sc /= 10;
  arduboy.drawChar(16, 2, sc%10+'0', 0, 1, 1);
}

void draw() {
  byte* buffer = arduboy.getBuffer();
  memcpy_P(buffer, background, sizeof(background));

  switch(frame & 3) {
    case 0:
    case 3:
    /* delete top rotor */
    buffer[90] |= 4;
    buffer[91] |= 4;
    buffer[92] |= 4;
    buffer[93] |= 4;
    buffer[94] |= 4;
    buffer[98] |= 4;
    buffer[99] |= 4;
    buffer[100] |= 4;
    buffer[101] |= 4;
    buffer[102] |= 4;
    if (frame & 1) break;
    case 1:
    /* delete front rotor */
    buffer[100] |= 16;
    buffer[101] |= 16;
    buffer[102] |= 16;
    buffer[103] |= 16;
    buffer[104] |= 16;
    buffer[108] |= 16;
    buffer[109] |= 16;
    buffer[110] |= 16;
    buffer[111] |= 16;
    buffer[112] |= 16;
    case 2:
    break;
  }

  const byte *const boats[] = {BT0, BT1, BT2};
  draw_static_sprite(boats[boat_pos]);

  for (byte t=0; t<3; t++){
    for (byte p=0; p<7; p++) {
      if (Tracks[t][p]) {
        draw_static_sprite(Tracks[t][p]);
      }
    }
  }
  drawScore();
}

#define LEFT_A_BUTTON_PRESSED 1
#define RIGHT_B_BUTTON_PRESSED 2

byte process_input(){
  static byte left = 0;
  static byte right=0;

  byte result = 0;
  
  if(arduboy.pressed(LEFT_BUTTON) || arduboy.pressed(A_BUTTON)) {
    if (left == 0){
      left = 1;
      result |= LEFT_A_BUTTON_PRESSED;
    }
  }
  else {
    left = 0;
  }
    
  if(arduboy.pressed(B_BUTTON) || arduboy.pressed(RIGHT_BUTTON)) {
     if (right == 0){
      right = 1;
      result |= RIGHT_B_BUTTON_PRESSED;
    }
  }
  else {
    right = 0;
  }

  return result;
}

void update_game(){
    frame += 1;
    if (frame % 8 == 0)
      arduboy.tunes.tone(523, 25);
}

void loop() {
  // put your main code here, to run repeatedly:

  byte input = process_input();

  if (miss >= 3){
    if(input == LEFT_A_BUTTON_PRESSED) {
      new_game('A');
      draw();
      arduboy.display();  
    }
    if(input == RIGHT_B_BUTTON_PRESSED) {
      new_game('B');
      draw();
      arduboy.display();  
    }
  }
  else{
    byte boat_moved = 0;
  
    if(input == LEFT_A_BUTTON_PRESSED && boat_pos > 0){
          boat_pos--;
          boat_moved = 1;    
    }
    if(input == RIGHT_B_BUTTON_PRESSED && boat_pos < 2){
          boat_pos++;
          boat_moved = 1;    
    }
  
    if (arduboy.nextFrame()){
      update_game();
      draw();
      arduboy.display();  
    }
    else if (boat_moved){
      draw();
      arduboy.display();
    }
  }
}
